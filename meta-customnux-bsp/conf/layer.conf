## meta-customnux-bsp/conf/layer.conf
```bitbake
BBPATH  =. "${LAYERDIR}:"
BBFILES += "  ${LAYERDIR}/recipes*/*/*.bb \
              ${LAYERDIR}/recipes*/*/*.bbappend \
"

BBFILE_COLLECTIONS += "customnux-bsp"
BBFILE_PATTERN_customnux-bsp = "^${LAYERDIR}/"
BBFILE_PRIORITY_customnux-bsp = "13"
LAYERSERIES_COMPAT_customnux-bsp = "${LAYERSERIES_COMPAT_core}"
```

## meta-customnux-bsp/conf/machine/raspberrypi4-64.conf
```bitbake
## meta-customnux/conf/machine/raspberrypi4-64.conf
#@TYPE: Machine
#@NAME: raspberrypi4-64 machine
#@DESCRIPTION: Machine configuration for running an raspberrypi4-64

require conf/machine/include/arm/armv8a/tune-cortexa72.inc

KERNEL_IMAGETYPE_UBOOT = "Image"
RPI_USE_U_BOOT = "1"
ARMSTUB = "armstub8-gic.bin"

KERNEL_IMAGETYPE = "Image"

MACHINE_FEATURES += " \
    vc4graphics \
    pci \
"

MACHINE_EXTRA_RDEPENDS += " \
    linux-firmware-rpidistro-bcm43455 \
    bluez-firmware-rpidistro-bcm4345c0-hcd \
"

# use default rpi from meta-raspberrypi and use custom raspberrypi4-64
MACHINEOVERRIDES =. "rpi:raspberrypi4-64:"

KERNEL_DEVICETREE = " \
    broadcom/bcm2711-rpi-4-b.dtb \
"

IMAGE_BOOT_FILES = " \
    fixup4.dat \
    start4.elf \
    start4x.elf \
    config.txt \
    vmlinux \
    System.map \
    u-boot.bin;kernel8.img \
    bcm2711-rpi-4-b.dtb \
    uboot.env \
    extlinux_a.conf;extlinux/extlinux.conf \
    extlinux_a.conf;extlinux/extlinux_a.conf \
    extlinux_b.conf;extlinux/extlinux_b.conf \
    ${KERNEL_IMAGETYPE} \
"
```

## meta-customnux-dashboard-dev/conf/layer.conf
```bitbake
BBPATH  =. "${LAYERDIR}:"
BBFILES += " \
    ${LAYERDIR}/recipes*/*/*.bb \
    ${LAYERDIR}/recipes*/*/*.bbappend \
"
BBFILE_COLLECTIONS += "customnux-dashboard-dev"
BBFILE_PATTERN_customnux-dashboard-dev = "^${LAYERDIR}/"
BBFILE_PRIORITY_customnux-dashboard-dev = "16"
LAYERSERIES_COMPAT_customnux-dashboard-dev = "${LAYERSERIES_COMPAT_core}"
```

## meta-customnux-dashboard/conf/layer.conf
```bitbake
require ${LAYERDIR}/conf/dashboard.conf

BBPATH  =. "${LAYERDIR}:"
BBFILES += "  \
    ${LAYERDIR}/recipes*/*/*.bb \
    ${LAYERDIR}/recipes*/*/*.bbappend \
"
BBFILE_COLLECTIONS += "customnux-dashboard"
BBFILE_PATTERN_customnux-dashboard = "^${LAYERDIR}/"
BBFILE_PRIORITY_customnux-dashboard = "15"
LAYERSERIES_COMPAT_customnux-dashboard = "${LAYERSERIES_COMPAT_core}"
```

## meta-customnux-distro/conf/distro/qemu-custom.conf
```bitbake
#@NAME: qemu-custom
#@DESCRIPTION: qemu-custom distro with features
# kernel: rpi-kernel

######################################### DEFAULT SETTINGS #########################################
DISTRO = "qemu-custom"
DISTRO_NAME = "qemu-custom"
DISTRO_VERSION = "1.0"
DISTRO_CODENAME = "kirkstone"

SDK_VENDOR = "-customnuxsdk"
SDK_VERSION = "${@d.getVar('DISTRO_VERSION').replace('snapshot-${DATE}', 'snapshot')}"
SDK_NAME = "${DISTRO}-${TCLIBC}-${SDKMACHINE}-${IMAGE_BASENAME}-${TUNE_PKGARCH}-${MACHINE}"
SDKPATHINSTALL = "/opt/${DISTRO}/${SDK_VERSION}"
TARGET_VENDOR = "-customnux"

MAINTAINER = "Siho Kim <kim125y@naver.com>"

LOCALCONF_VERSION = "1"

DISTRO_VERSION[vardepsexclude] = "DATE"
SDK_VERSION[vardepsexclude] = "DATE"

#DEFAULT_DISTRO_FEATURES = "largefile opengl ptest multiarch vulkan"
#DISTRO_FEATURES ?= "${DISTRO_FEATURES_DEFAULT} ${DEFAULT_DISTRO_FEATURES}"

DISTRO_FEATURES:append = " systemd"
DISTRO_FEATURES:remove = "sysvinit"
VIRTUAL-RUNTIME_init_manager = "systemd"
VIRTUAL-RUNTIME_initscripts = "systemd-compat-units"
DISTRO_FEATURES_BACKFILL_CONSIDERED = "sysvinit"

# QA check settings - a little stricter than the OE-Core defaults
WARN_TO_ERROR_QA = " \
    already-stripped compile-host-path install-host-path \
    installed-vs-shipped ldflags pn-overrides rpaths staticdev \
    unknown-configure-option useless-rpaths \
"
WARN_QA:remove = "${WARN_TO_ERROR_QA}"
ERROR_QA:append = " ${WARN_TO_ERROR_QA}"

require conf/distro/include/no-static-libs.inc
require conf/distro/include/yocto-uninative.inc
require conf/distro/include/security_flags.inc
INHERIT += "uninative"

# INHERIT += "reproducible_build"

BB_SIGNATURE_HANDLER ?= "OEEquivHash"
BB_HASHSERVE ??= "auto"

######################################### PREFERRED SETTINGS #########################################
PREFERRED_PROVIDER_virtual/kernel = "raspberry-kernel"
PREFERRED_PROVIDER_raspberry-kernel = "6.11%"

#PREFERRED_PROVIDER_virtual/kernel = "torvalds-kernel"
#PREFERRED_PROVIDER_torvalds-kernel = "6.11%"

######################################### CUSTOM SETTINGS #########################################
# default user
DEFAULT_USER = "great"
```

## meta-customnux-distro/conf/layer.conf
```bitbake
BBPATH  =. "${LAYERDIR}:"
BBFILES += "  ${LAYERDIR}/recipes*/*/*.bb \
              ${LAYERDIR}/recipes*/*/*.bbappend \
"

BBFILE_COLLECTIONS += "customnux-distro"
BBFILE_PATTERN_customnux-distro = "^${LAYERDIR}/"
BBFILE_PRIORITY_customnux-distro = "14"
LAYERDEPENDS_customnux-distro = "core"
LAYERSERIES_COMPAT_customnux-distro = "scarthgap"
```

## meta-customnux-distro/wic/customnux-image.wks
```
part /boot --source bootimg-partition --ondisk mmcblk0 --fstype=vfat --label boot --active --align 4096 --size 100
part / --source rootfs --ondisk mmcblk0 --fstype=ext4 --label rootfs_a --align 4 --size=0 --use-uuid --extra-space 2048
part --source empty --ondisk mmcblk0 --fstype=ext4 --label rootfs_b --align 4 --size=3072
```
